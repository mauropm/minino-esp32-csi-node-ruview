## sdkconfig.defaults
```kconfig
# Minino ESP32-C6 CSI Node - SDK Defaults
# ESP-IDF v6.x Configuration
# Target: Electronic Cats Minino (ESP32-C6)

# =============================================================================
# Target Platform
# =============================================================================
CONFIG_IDF_TARGET="esp32c6"

# =============================================================================
# Flash Configuration
# =============================================================================
CONFIG_ESPTOOLPY_FLASHSIZE_8MB=y
CONFIG_ESPTOOLPY_FLASHSIZE="8MB"
CONFIG_ESPTOOLPY_FLASHMODE="dio"
CONFIG_ESPTOOLPY_FLASHFREQ="80m"
CONFIG_PARTITION_TABLE_CUSTOM=y
CONFIG_PARTITION_TABLE_CUSTOM_FILENAME="partitions_4mb.csv"

# =============================================================================
# WiFi Configuration
# =============================================================================
CONFIG_ESP_WIFI_ENABLED=y
CONFIG_ESP_WIFI_CSI_ENABLED=y
CONFIG_ESP_WIFI_SLP_MODE=y
CONFIG_ESP_WIFI_RXBA_WIN=6
CONFIG_ESP_WIFI_TXBA_WIN=6
CONFIG_ESP_WIFI_RX_IRAM_OPT=y
CONFIG_ESP_WIFI_EXTRA_IRAM_OPT=y

# =============================================================================
# WiFi Credentials (Override via NVS provision script)
# =============================================================================
CONFIG_CSI_WIFI_SSID="wifi-densepose"
CONFIG_CSI_WIFI_PASSWORD=""
CONFIG_CSI_TARGET_IP="192.168.1.100"
CONFIG_CSI_TARGET_PORT=5005
CONFIG_CSI_NODE_ID=1
CONFIG_CSI_WIFI_CHANNEL=6

# =============================================================================
# Edge Intelligence (ADR-039)
# =============================================================================
CONFIG_EDGE_TIER=2
CONFIG_EDGE_FALL_THRESH=2000
CONFIG_EDGE_VITAL_INTERVAL_MS=1000
CONFIG_EDGE_TOP_K=8
CONFIG_EDGE_POWER_DUTY=100

# =============================================================================
# FreeRTOS Configuration
# =============================================================================
CONFIG_FREERTOS_HZ=1000
CONFIG_FREERTOS_DEFAULT_TASK_PRIORITY=5
CONFIG_ESP_MAIN_TASK_STACK_SIZE=8192
CONFIG_ESP_SYSTEM_EVENT_TASK_STACK_SIZE=4096

# =============================================================================
# LWIP Network Stack
# =============================================================================
CONFIG_LWIP_SO_RCVBUF=y
CONFIG_LWIP_SO_REUSE=y
CONFIG_LWIP_MAX_SOCKETS=10

# =============================================================================
# NVS Configuration
# =============================================================================
CONFIG_NVS_ENCRYPTION_ENABLE=n

# =============================================================================
# Logging
# =============================================================================
CONFIG_LOG_DEFAULT_LEVEL_INFO=y
CONFIG_LOG_DEFAULT_LEVEL=3
CONFIG_BOOTLOADER_LOG_LEVEL_WARN=y

# =============================================================================
# Power Management
# =============================================================================
CONFIG_PM_ENABLE=y
CONFIG_PM_DFS_FREQ_AUTO=y

# =============================================================================
# Compiler Optimization
# =============================================================================
CONFIG_COMPILER_OPTIMIZATION_SIZE=y

# =============================================================================
# Application Version
# =============================================================================
CONFIG_APP_PROJECT_VER_FROM_CONFIG=y
CONFIG_APP_REPRODUCIBLE_BUILD=y

# =============================================================================
# ADC Calibration (for battery voltage on Minino)
# =============================================================================
CONFIG_ADC_CAL_EFUSE_V25_ENABLE=y
CONFIG_ADC_CAL_EFUSE_TP_ENABLE=y

# =============================================================================
# I2C (for OLED display)
# =============================================================================
CONFIG_I2C_ENABLE=y
CONFIG_I2C_MASTER_ISR_IN_IRAM=y

# =============================================================================
# SPI (for SD card)
# =============================================================================
CONFIG_SPI_MASTER_ISR_IN_IRAM=y

# =============================================================================
# UART (for GPS module)
# =============================================================================
CONFIG_UART_ISR_IN_IRAM=y

# =============================================================================
# Security (disabled by default for development)
# =============================================================================
CONFIG_SECURE_BOOT_ENABLE=n
CONFIG_FLASH_ENCRYPTION_ENABLE=n

# =============================================================================
# WiFi 6 Features (ESP32-C6 specific)
# =============================================================================
CONFIG_ESP_WIFI_11KV_SUPPORT=y
CONFIG_ESP_WIFI_SOFTAP_SUPPORT=y

# Disable display for Minino (optional - can be enabled later)
CONFIG_DISPLAY_ENABLE=n
```

## sdkconfig.defaults.minino
```kconfig
# Minino (ESP32-C6) SDK Configuration
# ESP-IDF v6.x
# Target: Electronic Cats Minino

# =============================================================================
# Target Configuration
# =============================================================================
CONFIG_IDF_TARGET="esp32c6"

# =============================================================================
# Flash Configuration (Minino: 8MB Flash)
# =============================================================================
CONFIG_ESPTOOLPY_FLASHSIZE_8MB=y
CONFIG_ESPTOOLPY_FLASHSIZE="8MB"
CONFIG_ESPTOOLPY_FLASHMODE="dio"
CONFIG_ESPTOOLPY_FLASHFREQ="80m"

# Partition table
CONFIG_PARTITION_TABLE_CUSTOM=y
CONFIG_PARTITION_TABLE_CUSTOM_FILENAME="partitions_4mb.csv"

# =============================================================================
# ESP32-C6 Specific Configuration
# =============================================================================

# CPU: RISC-V @ 160MHz
CONFIG_ESP_SYSTEM_EVENT_TASK_STACK_SIZE=4096
CONFIG_ESP_MAIN_TASK_STACK_SIZE=8192

# WiFi Configuration for ESP32-C6
CONFIG_ESP_WIFI_ENABLED=y
CONFIG_ESP_WIFI_CSI_ENABLED=y
CONFIG_ESP_WIFI_SLP_MODE=y

# WiFi buffer configuration
CONFIG_ESP_WIFI_RX_IRAM_OPT=y
CONFIG_ESP_WIFI_RXBA_WIN=6
CONFIG_ESP_WIFI_TXBA_WIN=6

# =============================================================================
# FreeRTOS Configuration
# =============================================================================
CONFIG_FREERTOS_HZ=1000
CONFIG_FREERTOS_DEFAULT_TASK_PRIORITY=5
CONFIG_FREERTOS_IDLE_TASK_STACKSIZE=4096
CONFIG_FREERTOS_TIMER_TASK_PRIORITY=4
CONFIG_FREERTOS_TIMER_TASK_STACK_DEPTH=4096
CONFIG_FREERTOS_TIMER_USE esp32c6=y

# =============================================================================
# Log Configuration
# =============================================================================
CONFIG_LOG_DEFAULT_LEVEL_INFO=y
CONFIG_LOG_DEFAULT_LEVEL=3
CONFIG_LOG_TIMESTAMP_SOURCE_RTOS=y

# =============================================================================
# LWIP Configuration
# =============================================================================
CONFIG_LWIP_SO_RCVBUF=y
CONFIG_LWIP_SO_REUSE=y
CONFIG_LWIP_SO_LINGER=y
CONFIG_LWIP_MAX_SOCKETS=10

# =============================================================================
# NVS Configuration
# =============================================================================
CONFIG_NVS_ENCRYPTION_ENABLE=n
CONFIG_NVS_NAMESPACE_MAX_LENGTH=15

# =============================================================================
# ADC Configuration (for battery voltage)
# =============================================================================
CONFIG_ADC_CAL_EFUSE_V25_ENABLE=y
CONFIG_ADC_CAL_EFUSE_TP_ENABLE=y

# =============================================================================
# ESP32-C6 Power Management
# =============================================================================
CONFIG_PM_ENABLE=y
CONFIG_PM_DFS_FREQ_AUTO=y

# =============================================================================
# RISC-V Specific
# =============================================================================
CONFIG_ESP_SYSTEM_MEMPROT_FEATURE=y

# =============================================================================
# Disable ESP32-S3 specific features
# =============================================================================
# CONFIG_IDF_TARGET_ESP32S3 is not set
# CONFIG_IDF_TARGET_ESP32 is not set
# CONFIG_IDF_TARGET_ESP32C3 is not set

# =============================================================================
# Application Configuration
# =============================================================================
CONFIG_APP_PROJECT_VER_FROM_CONFIG=y
CONFIG_APP_REPRODUCIBLE_BUILD=y

# =============================================================================
# SPI Configuration (for SD card)
# =============================================================================
CONFIG_SPI_MASTER_ISR_IN_IRAM=y

# =============================================================================
# I2C Configuration (for OLED display)
# =============================================================================
CONFIG_I2C_ENABLE=y
CONFIG_I2C_MASTER_ISR_IN_IRAM=y

# =============================================================================
# UART Configuration (for GPS)
# =============================================================================
CONFIG_UART_ISR_IN_IRAM=y

# =============================================================================
# Heap Memory Configuration
# =============================================================================
CONFIG_HEAP_TRACING_OFF=y
CONFIG_HEAP_POISONING_DISABLED=y

# =============================================================================
# ESP32-C6 WiFi 6 Features
# =============================================================================
CONFIG_ESP_WIFI_11KV_SUPPORT=y
CONFIG_ESP_WIFI_SOFTAP_SUPPORT=y

# =============================================================================
# Security
# =============================================================================
CONFIG_SECURE_BOOT_ENABLE=n
CONFIG_FLASH_ENCRYPTION_ENABLE=n

# =============================================================================
# Minimal Build Options
# =============================================================================
CONFIG_COMPILER_OPTIMIZATION_SIZE=y
CONFIG_BOOTLOADER_LOG_LEVEL_WARN=y
```
